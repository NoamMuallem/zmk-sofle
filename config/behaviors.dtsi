// Custom behaviors (hold-tap/long-press helper)
#include <dt-bindings/zmk/keys.h>

/ {
    behaviors {
        /* Use: &lp <HOLD_key> <TAP_key>
         * Ex:  &lp ESC GRAVE   => tap ` , hold Esc
         */
        lp: long_press_to_key {
            compatible = "zmk,behavior-hold-tap";
            label = "LP";
            #binding-cells = <2>;
            flavor = "tap-preferred";
            tapping-term-ms = <200>;
            quick-tap-ms = <175>;
            bindings = <&kp>, <&kp>;
        };
    };
};
